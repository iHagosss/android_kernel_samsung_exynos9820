## kernel/kernelsu-next/Kconfig
```kconfig
# SPDX-License-Identifier: GPL-2.0
#
# KernelSU-Next config stub for Exynos9820.
#

config KSU
	bool "KernelSU-Next support"
	depends on KPROBES
	default y
	help
	  Enable KernelSU-Next integration for this kernel tree.
	  This is a minimal compatibility stub for the Exynos9820 build.

config KSU_DEBUG
	bool "KernelSU-Next debug mode"
	depends on KSU
	default n
	help
	  Enable KernelSU-Next debug logging.

config KSU_DISABLE_MANAGER
	bool "Disable KernelSU-Next manager integration"
	depends on KSU
	default y
	help
	  Disable Android manager integration in this build.
```
